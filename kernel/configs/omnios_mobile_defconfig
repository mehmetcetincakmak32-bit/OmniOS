## kernel/configs/omnios_mobile_defconfig
```kconfig
/* OmniOS Mobile Kernel Config - Linux 6.6 LTS
 * Target: ARMv8 (aarch64) + x86_64 (QEMU development)
 * SPDX-License-Identifier: MIT
 */

# General
CONFIG_64BIT=y
CONFIG_ARM64=y
CONFIG_SMP=y
CONFIG_NR_CPUS=8

# Preemption - Full preempt for mobile UI latency
CONFIG_PREEMPT=y
CONFIG_PREEMPT_BUILD=y
CONFIG_PREEMPT_RT=n

CONFIG_HZ=250
CONFIG_NO_HZ_IDLE=y
CONFIG_NO_HZ_FULL=y
CONFIG_HIGH_RES_TIMERS=y

# Memory
CONFIG_COMPACTION=y
CONFIG_CMA=y
CONFIG_CMA_SIZE_MB=128
CONFIG_CMA_ALIGNMENT=8
CONFIG_ZSWAP=y
CONFIG_ZSWAP_COMPRESSOR_DEFAULT_LZ4=y
CONFIG_ZSWAP_ZPOOL_DEFAULT_Z3FOLD=y

# Scheduler - EEVDF default + EAS + uclamp
CONFIG_SMP=y
CONFIG_ENERGY_MODEL=y
CONFIG_FAIR_GROUP_SCHED=y
CONFIG_CGROUP_SCHED=y
CONFIG_UCLAMP_TASK=y
CONFIG_UCLAMP_BUCKETS_COUNT=5
CONFIG_CGROUP_CPU=y

# CGroups for Waydroid
CONFIG_CGROUPS=y
CONFIG_CGROUP_CPUACCT=y
CONFIG_MEMCG=y
CONFIG_MEMCG_SWAP=y
CONFIG_BLK_CGROUP=y
CONFIG_CGROUP_FREEZER=y
CONFIG_CGROUP_DEVICE=y
CONFIG_CGROUP_BPF=y

# Namespaces (Waydroid container)
CONFIG_NAMESPACES=y
CONFIG_PID_NS=y
CONFIG_NET_NS=y
CONFIG_UTS_NS=y
CONFIG_IPC_NS=y
CONFIG_USER_NS=y

# Android/Waydroid compatibility
CONFIG_ANDROID_BINDER_IPC=y
CONFIG_MEMFD_CREATE=y
CONFIG_DMABUF_HEAPS=y
CONFIG_DMABUF_HEAPS_SYSTEM=y
CONFIG_DMABUF_HEAPS_CMA=y
CONFIG_CMA=y
CONFIG_CMA_SIZE_MB=128
CONFIG_CMA_ALIGNMENT=8
CONFIG_VSOCKETS=y
CONFIG_VHOST_VSOCK=y

# Security - Seccomp-BPF based (no SELinux/AppArmor)
CONFIG_SECURITY=y
CONFIG_SECURITY_NETY_NETWORK=y
CONFIG_SECURITY_PATH=y
CONFIG_SECCOMP=y
CONFIG_SECCOMP_FILTER=y
CONFIG_HARDENED_USERCOPY=y
CONFIG_FORTIFY_SOURCE=y
CONFIG_HARDENED_USERCOPY_FALLBACK=y
CONFIG_DEBUG_RODATA=y
CONFIG_DEBUG_SET_MODULE_RONX=y
CONFIG_DEBUG_RODATA_TEST=y
CONFIG_STRICT_DEVMEM=y
CONFIG_DEBUG_SET_MODULE_RONX=y
CONFIG_DEBUG_WX=y
CONFIG_DEBUG_LIST=y
CONFIG_DEBUG_SG=y
CONFIG_DEBUG_NOTIFIERS=y
CONFIG_DEBUG_CREDENTIALS=y
CONFIG_DEBUG_FORCE_WEAK_PER_CPU=y

# Filesystem
CONFIG_EXT4_FS=y
CONFIG_EXT4_FS_POSIX_ACL=y
CONFIG_EXT4_FS_SECURITY=y
CONFIG_F2FS_FS=y
CONFIG_OVERLAY_FS=y
CONFIG_OVERLAY_FS_REDIRECT_DIR=y
CONFIG_OVERLAY_FS_REDIRECT_ALWAYS_FOLLOW=y
CONFIG_SQUASHFS=y
CONFIG_SQUASHFS_XATTR=y
CONFIG_SQUASHFS_ZLIB=y
CONFIG_SQUASHFS_LZ4=y
CONFIG_SQUASHFS_XZ=y

# Block
CONFIG_BLK_DEV_LOOP=y
CONFIG_BLK_DEV_NBD=y
CONFIG_BLK_DEV_ZONED=y

# Display
CONFIG_DRM=y
CONFIG_DRM_KMS_HELPER=y
CONFIG_DRM_SIMPLEDRM=y
CONFIG_DRM_VIRTIO_GPU=y
CONFIG_DRM_PANEL_ORIENTATION_QUIRKS=y

# VirtIO / QEMU
CONFIG_VIRTIO=y
CONFIG_VIRTIO_PCI=y
CONFIG_VIRTIO_BLK=y
CONFIG_VIRTIO_NET=y
CONFIG_VIRTIO_GPU=y
CONFIG_VIRTIO_INPUT=y
CONFIG_VIRTIO_CONSOLE=y
CONFIG_VIRTIO_VSOCK=y
CONFIG_VHOST_VSOCK=y

# Network
CONFIG_NET=y
CONFIG_INET=y
CONFIG_NETFILTER=y
CONFIG_NF_NAT=y
CONFIG_NF_NAT_MASQUERADE=y
CONFIG_NFT_NAT=y
CONFIG_IP_NF_NAT=y
CONFIG_IP_NF_TARGET_MASQUERADE=y

# Crypto
CONFIG_CRYPTO_SHA256=y
CONFIG_CRYPTO_AES=y
CONFIG_CRYPTO_USER_API_HASH=y
CONFIG_CRYPTO_USER_API_SKCIPHER=y
CONFIG_DM_VERITY=y
CONFIG_DM_VERITY_FEC=y
CONFIG_MEMFD_CREATE=y

# Debug
CONFIG_DEBUG_FS=y
CONFIG_DEBUG_KERNEL=y
CONFIG_DEBUG_INFO=y
CONFIG_DEBUG_INFO_BTF=y
CONFIG_DEBUG_INFO_DWARF5=y

# Module
CONFIG_MODULES=y
CONFIG_MODULE_UNLOAD=y
CONFIG_MODVERSIONS=y
CONFIG_MODULE_SIG=n

# Explicitly disable
CONFIG_TRANSPARENT_HUGEPAGE=n
CONFIG_SECURITY_SELINUX=n
CONFIG_SECURITY_APPARMOR=n
CONFIG_FB_SIMPLE=n
```

## kernel/configs/omnios_x86_64_defconfig
```kconfig
/* OmniOS — kernel/configs/omnios_x86_64_defconfig */
/* x86_64 QEMU/KVM development target */
/* Faz 1 Foundation + SMP */
/* SPDX-License-Identifier: MIT */

# Architecture
CONFIG_64BIT=y
CONFIG_X86_64=y
CONFIG_SMP=y
CONFIG_NR_CPUS=8

# Preemption
CONFIG_PREEMPT=y
CONFIG_PREEMPT_BUILD=y
CONFIG_HZ=250
CONFIG_NO_HZ_IDLE=y
CONFIG_HIGH_RES_TIMERS=y

# Memory
CONFIG_COMPACTION=y
CONFIG_CMA=y
CONFIG_CMA_SIZE_MB=128
CONFIG_PAGE_TABLE_ISOLATION=y
CONFIG_RANDOMIZE_MEMORY=y

# Scheduler
CONFIG_SMP=y
CONFIG_ENERGY_MODEL=y
CONFIG_FAIR_GROUP_SCHED=y
CONFIG_CGROUP_SCHED=y
CONFIG_UCLAMP_TASK=y
CONFIG_UCLAMP_BUCKETS_COUNT=5
CONFIG_CGROUP_CPU=y

# CGroups
CONFIG_CGROUPS=y
CONFIG_CGROUP_CPUACCT=y
CONFIG_MEMCG=y
CONFIG_MEMCG_SWAP=y
CONFIG_BLK_CGROUP=y
CONFIG_CGROUP_FREEZER=y
CONFIG_CGROUP_DEVICE=y
CONFIG_CGROUP_BPF=y

# Namespaces
CONFIG_NAMESPACES=y
CONFIG_PID_NS=y
CONFIG_NET_NS=y
CONFIG_UTS_NS=y
CONFIG_IPC_NS=y
CONFIG_USER_NS=y

# Security
CONFIG_SECURITY=y
CONFIG_SECCOMP=y
CONFIG_SECCOMP_FILTER=y
CONFIG_HARDENED_USERCOPY=y
CONFIG_FORTIFY_SOURCE=y
CONFIG_DEBUG_RODATA=y
CONFIG_STRICT_DEVMEM=y

# Filesystem
CONFIG_EXT4_FS=y
CONFIG_F2FS_FS=y
CONFIG_OVERLAY_FS=y
CONFIG_SQUASHFS=y
CONFIG_SQUASHFS_XATTR=y
CONFIG_SQUASHFS_LZ4=y

# VirtIO
CONFIG_VIRTIO=y
CONFIG_VIRTIO_PCI=y
CONFIG_VIRTIO_BLK=y
CONFIG_VIRTIO_NET=y
CONFIG_VIRTIO_GPU=y
CONFIG_VIRTIO_INPUT=y
CONFIG_VIRTIO_CONSOLE=y
CONFIG_VHOST_VSOCK=y

# Display
CONFIG_DRM=y
CONFIG_DRM_KMS_HELPER=y
CONFIG_DRM_VIRTIO_GPU=y
CONFIG_DRM_BOCHS=y
CONFIG_DRM_SIMPLEDRM=y

# PCI
CONFIG_PCI=y
CONFIG_PCI_MSI=y
CONFIG_PCI_MSI_IRQ_DOMAIN=y

# Network
CONFIG_NET=y
CONFIG_INET=y
CONFIG_NETFILTER=y
CONFIG_NF_NAT=y

# Serial/UART
CONFIG_SERIAL_8250=y
CONFIG_SERIAL_8250_CONSOLE=y
CONFIG_SERIAL_CORE=y
CONFIG_SERIAL_CORE_CONSOLE=y

# Input
CONFIG_INPUT=y
CONFIG_INPUT_KEYBOARD=y
CONFIG_INPUT_MOUSE=y
CONFIG_KEYBOARD_ATKBD=y
CONFIG_MOUSE_PS2=y

# Power management
CONFIG_ACPI=y
CONFIG_ACPI_BUTTON=y
CONFIG_ACPI_FAN=y
CONFIG_ACPI_PROCESSOR=y

# Debug
CONFIG_DEBUG_FS=y
CONFIG_DEBUG_KERNEL=y
CONFIG_DEBUG_INFO=y
CONFIG_DEBUG_INFO_BTF=y

# Module support
CONFIG_MODULES=y
CONFIG_MODULE_UNLOAD=y
CONFIG_MODVERSIONS=y

# Disable
CONFIG_TRANSPARENT_HUGEPAGE=n
CONFIG_SECURITY_SELINUX=n
CONFIG_SECURITY_APPARMOR=n
```
